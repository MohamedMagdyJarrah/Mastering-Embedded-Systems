VERSION ""

NS_ :

BS_:

BU_: ECU2_SPEED ECU1_ACC_CMD

BO_ 939 Speed_Message: 1 ECU2_SPEED
 SG_ Speed_VAL : 0|8@1+ (1,0) [0|255] ""  ECU1_ACC_CMD

BO_ 48 Acceleration_Message: 1 ECU1_ACC_CMD
 SG_ ACC_VAL : 0|8@1+ (1,0) [0|1] ""  ECU2_SPEED
